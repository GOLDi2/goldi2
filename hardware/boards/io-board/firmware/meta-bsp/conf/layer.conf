## hardware/boards/io-board/firmware/meta-bsp/conf/layer.conf
```bitbake
# We have a conf and classes directory, add to BBPATH
BBPATH .= ":${LAYERDIR}"

# We have recipes-* directories, add to BBFILES
BBFILES += "${LAYERDIR}/recipes-*/*/*.bb \
            ${LAYERDIR}/recipes-*/*/*.bbappend"

BBFILE_COLLECTIONS += "meta-bsp"
BBFILE_PATTERN_meta-bsp = "^${LAYERDIR}/"
BBFILE_PRIORITY_meta-bsp = "10"

LAYERDEPENDS_meta-bsp = "core"
LAYERSERIES_COMPAT_meta-bsp = "honister"

CORE_IMAGE_EXTRA_INSTALL += "fpga-firmware"
```

## hardware/os/meta-goldi-bsp/conf/layer.conf
```bitbake
# We have a conf and classes directory, add to BBPATH
BBPATH .= ":${LAYERDIR}"

# We have recipes-* directories, add to BBFILES
BBFILES += "${LAYERDIR}/recipes-*/*/*.bb \
            ${LAYERDIR}/recipes-*/*/*.bbappend"

BBFILE_COLLECTIONS += "meta-goldi-bsp"
BBFILE_PATTERN_meta-goldi-bsp = "^${LAYERDIR}/"
BBFILE_PRIORITY_meta-goldi-bsp = "10"

LAYERDEPENDS_meta-goldi-bsp = "core"
LAYERSERIES_COMPAT_meta-goldi-bsp = "honister"
```

## hardware/os/meta-goldi-bsp/conf/machine/io-board.conf
```bitbake
#@TYPE: Machine
#@NAME: RaspberryPi 4 Development Board (64bit)
#@DESCRIPTION: Machine configuration for the RaspberryPi 4 in 64 bits mode

MACHINEOVERRIDES = "raspberrypi4:${MACHINE}"

APPLICATION_ARCHIVE = "https://gitlab.tu-ilmenau.de/api/v4/projects/3776/packages/generic/io_board/0.0.1/dist.tar.gz"
APPLICATION_ARCHIVE_CHECKSUM = "60431e4612e4eee9c04092a1e9bdeda4522513bb9649104a9829b0bc2c539f40"

IMAGE_FSTYPES = "ext4 wic.bz2 wic.bmap"
WKS_FILE = "eeprom_cm4.wks"

MACHINE_FEATURES = "pci qemu-usermode"
MACHINE_EXTRA_RRECOMMENDS += "\
    linux-firmware-rpidistro-bcm43455 \
    bluez-firmware-rpidistro-bcm4345c0-hcd \
"

require conf/machine/include/arm/armv8a/tune-cortexa72.inc
include conf/machine/include/rpi-base.inc

MACHINE_FEATURES_BACKFILL_CONSIDERED = "qemu-usermode rtc"

RPI_KERNEL_DEVICETREE = " \
    broadcom/bcm2711-rpi-cm4.dtb \
"

RPI_KERNEL_DEVICETREE_OVERLAYS = " \
    overlays/overlay_map.dtb \
    overlays/microcontroller.dtbo \
"

SDIMG_KERNELIMAGE ?= "kernel8.img"
SERIAL_CONSOLES ?= "115200;ttyS0"

ENABLE_UART = "1"
CORE_FREQ = "250"
ENABLE_DWC2_HOST = "1"
DISABLE_SPLASH = "1"
DISABLE_RPI_BOOT_LOGO = "1"
BOOT_DELAY = "0"
BOOT_DELAY_MS = "0"

RPI_USE_U_BOOT = "1"
PREFERRED_PROVIDER_virtual/bootloader = "u-boot"
UBOOT_MACHINE = "rpi_arm64_config"

VC4DTBO ?= "vc4-kms-v3d"

# When u-boot is enabled we need to use the "Image" format and the "booti"
# command to load the kernel
KERNEL_IMAGETYPE_UBOOT ?= "Image"
# "zImage" not supported on arm64 and ".gz" images not supported by bootloader yet
KERNEL_IMAGETYPE_DIRECT ?= "Image"
KERNEL_BOOTCMD ?= "booti"

ARMSTUB ?= "armstub8-gic.bin"

PACKAGE_FEED_ARCHS:append = "io-board"
```

## hardware/os/meta-goldi-bsp/wic/eeprom_cm4.wks
```
part --fstype=vfat --align 4096 --fixed-size 128 --label boot --source bootimg-partition --active
part --fstype=ext4 --align 4096 --fixed-size 3072 --label A --source rootfs
part --fstype=ext4 --align 4096 --fixed-size 3072 --label B
part --fstype=ext4 --align 4096 --size 256 --label data --fsoptions "x-systemd.growfs"
```

## hardware/os/meta-goldi-distro/conf/distro/goldi-distro.conf
```bitbake
require conf/distro/poky.conf

DISTRO = "goldi-distro"
DISTRO_NAME = "The GOLDi embedded distro"
DISTRO_VERSION = "0.0.1"
DISTRO_CODENAME = "hardknott"

POKY_DEFAULT_DISTRO_FEATURES = "largefile opengl"
POKY_DEFAULT_EXTRA_RDEPENDS = "packagegroup-core-boot"
POKY_DEFAULT_EXTRA_RRECOMMENDS = ""

DISTRO_FEATURES = "pci ipv4 ipv6 usbhost systemd rauc"

VIRTUAL-RUNTIME_init_manager = "systemd"
DISTRO_FEATURES_BACKFILL_CONSIDERED = "sysvinit"
VIRTUAL-RUNTIME_initscripts = ""

PACKAGE_CLASSES = "package_ipk"

# Enable LFS - see bug YOCTO #5865
DISTRO_FEATURES:append_libc-uclibc = " largefile"
DISTRO_FEATURES:append_libc-musl = " largefile"

IMAGE_INSTALL:append = " wget rauc u-boot nodejs avahi-daemon goldi2-hardware-admin svf-player avrdude mkoverlaydir resetpassword python3-goldi goldi-board-test fpga-firmware manual-control-script goldi-vpn growpart"

PACKAGECONFIG:append_pn-gstreamer1.0-plugins-bad = " webrtc srtp"

PACKAGE_FEED_URIS = "https://package.goldi-labs.de"
PACKAGE_FEED_BASE_PATHS = "ipk-dev"
PACKAGE_FEED_ARCHS = "all cortexa72 cortexa7hf-neon cortexa7t2hf-neon"
```

## hardware/os/meta-goldi-distro/conf/layer.conf
```bitbake
# We have a conf and classes directory, add to BBPATH
BBPATH .= ":${LAYERDIR}"

# We have recipes-* directories, add to BBFILES
BBFILES += "${LAYERDIR}/recipes-*/*/*.bb \
            ${LAYERDIR}/recipes-*/*/*.bbappend"

BBFILE_COLLECTIONS += "meta-goldi-distro"
BBFILE_PATTERN_meta-goldi-distro = "^${LAYERDIR}/"
BBFILE_PRIORITY_meta-goldi-distro = "10"

LAYERDEPENDS_meta-goldi-distro = "core"
LAYERSERIES_COMPAT_meta-goldi-distro = "dunfell"
```

## hardware/os/meta-goldi/conf/layer.conf
```bitbake
# We have a conf and classes directory, add to BBPATH
BBPATH .= ":${LAYERDIR}"

# We have recipes-* directories, add to BBFILES
BBFILES += "${LAYERDIR}/recipes-*/*/*.bb \
            ${LAYERDIR}/recipes-*/*/*.bbappend"

BBFILE_COLLECTIONS += "meta-goldi"
BBFILE_PATTERN_meta-goldi = "^${LAYERDIR}/"
BBFILE_PRIORITY_meta-goldi = "6"

LAYERDEPENDS_meta-goldi = "core"
LAYERSERIES_COMPAT_meta-goldi = "honister"
```
